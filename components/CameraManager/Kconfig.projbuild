## components/CameraManager/Kconfig.projbuild
```kconfig
menu "Camera sensor pinout configuration"

    orsource "$IDF_PATH/examples/common_components/env_caps/$IDF_TARGET/Kconfig.env_caps"

    config CAMERA_MODULE_NAME
        string "Camera module name"
        default "ESP32S3_XIAO_SENSE"
        help 
            Camera module name

    config PWDN_GPIO_NUM
        int "Power Down GPIO Number"
        default -1
        help
            Power Down GPIO number

    config RESET_GPIO_NUM
        int "Reset GPIO Number"
        default -1
        help
            Reset GPIO number

    config XCLK_GPIO_NUM
        int "External Clock (XCLK) GPIO Number"
        default 10
        help
            External Clock GPIO number (set to GPIO 4)

    config SIOD_GPIO_NUM
        int "Serial Data I/O (SIOD) GPIO Number"
        default 40
        help
            Serial Data I/O (SDA) GPIO number (set to GPIO 18)

    config SIOC_GPIO_NUM
        int "Serial Clock (SIOC) GPIO Number"
        default 39
        help
            Serial Clock (SCL) GPIO number (set to GPIO 23)

    config Y9_GPIO_NUM
        int "Y9 Data Bit GPIO Number"
        default 48
        help
            Y9 Data bit GPIO number (set to GPIO 36)

    config Y8_GPIO_NUM
        int "Y8 Data Bit GPIO Number"
        default 11
        help
            Y8 Data bit GPIO number (set to GPIO 37)

    config Y7_GPIO_NUM
        int "Y7 Data Bit GPIO Number"
        default 12
        help
            Y7 Data bit GPIO number (set to GPIO 38)

    config Y6_GPIO_NUM
        int "Y6 Data Bit GPIO Number"
        default 14
        help
            Y6 Data bit GPIO number (set to GPIO 39)

    config Y5_GPIO_NUM
        int "Y5 Data Bit GPIO Number"
        default 16
        help
            Y5 Data bit GPIO number (set to GPIO 14)

    config Y4_GPIO_NUM
        int "Y4 Data Bit GPIO Number"
        default 18
        help
            Y4 Data bit GPIO number (set to GPIO 19)

    config Y3_GPIO_NUM
        int "Y3 Data Bit GPIO Number"
        default 17
        help
            Y3 Data bit GPIO number (set to GPIO 13)

    config Y2_GPIO_NUM
        int "Y2 Data Bit GPIO Number"
        default 15
        help
            Y2 Data bit GPIO number (set to GPIO 34)

    config VSYNC_GPIO_NUM
        int "Vertical Sync (VSYNC) GPIO Number"
        default 38
        help
            Vertical Sync GPIO number (set to GPIO 5)

    config HREF_GPIO_NUM
        int "Horizontal Reference (HREF) GPIO Number"
        default 47
        help
            Horizontal Reference GPIO number (set to GPIO 27)

    config PCLK_GPIO_NUM
        int "Pixel Clock (PCLK) GPIO Number"
        default 13
        help
            Pixel Clock GPIO number (set to GPIO 25)

endmenu

menu "Camera power control and recovery"

    config CAMERA_POWER_CONTROL
        bool "Camera power (CAM_CE) and reset (CAM_RESET) lines"
        default n
        help
            Drives the enable of the camera LDOs and the camera reset line, both as
            open drain: pulled low or released, never driven high. A probe at boot
            finds out whether the board routes the lines; where it does not, every
            operation reports not_available and nothing changes.
            Adds get_camera_status. Enable only in the configs of boards that have
            these nets.

    config CAMERA_POWER_EN_GPIO
        int "CAM_CE GPIO (enable of both camera LDOs)"
        depends on CAMERA_POWER_CONTROL
        range -1 48
        default -1
        help
            Must have an external pull-up to 3V3 so a released line keeps the
            camera powered. Never driven high.

    config CAMERA_HW_RESET_GPIO
        int "CAM_RESET GPIO"
        depends on CAMERA_POWER_CONTROL
        range -1 48
        default -1
        help
            Camera reset line with an external pull-up. Keep RESET_GPIO_NUM at -1:
            the camera driver would drive its own reset pin push-pull.

    config CAMERA_RAIL_SENSE
        bool "Prove the camera rail collapsed (DVP pads over ADC2)"
        depends on CAMERA_POWER_CONTROL && !GENERAL_ENABLE_WIRELESS
        default n
        help
            During a power cycle two DVP data pads are read over ADC2 with the
            internal pull-up. A camera output PMOS clamps its pad to the camera
            rail, so a low reading bounds the rail from above. Needs ADC2, which
            Wi-Fi occupies, hence no wireless.

    config CAMERA_RAIL_SENSE_GPIO_A
        int "Rail sense pad A (a DVP data pin on ADC2)"
        depends on CAMERA_RAIL_SENSE
        range -1 48
        default -1

    config CAMERA_RAIL_SENSE_GPIO_B
        int "Rail sense pad B (a DVP data pin on ADC2)"
        depends on CAMERA_RAIL_SENSE
        range -1 48
        default -1

    config CAMERA_RECOVERY_ENABLE
        bool "Camera recovery while streaming"
        depends on !GENERAL_ENABLE_WIRELESS
        default n
        help
            Frame gate around every frame UVC takes from the driver, a worker task
            that restarts the camera (reinit, hardware reset or power cycle) and the
            recover_camera command. Without wireless because the HTTP stream server
            would be a second frame consumer the gate does not cover.

    config CAMERA_AUTO_RECOVERY
        bool "Restart the camera automatically"
        depends on CAMERA_RECOVERY_ENABLE
        default n
        help
            frame_timeout: a consumer got no frame (the driver waited 4 s, up to
            8 s on the S3). boot_failure: the first camera init failed. Limited by
            a cooldown, a suspension after three failures in a row and at most ten
            automatic attempts in ten minutes.

    config CAMERA_AUTO_RECOVERY_MISSED_FRAMES
        int "Missing frames in a row before an automatic restart"
        depends on CAMERA_AUTO_RECOVERY
        range 1 10
        default 1

    config CAMERA_RECOVERY_ESP_RESTART
        bool "Restart the ESP when automatic recovery is suspended"
        depends on CAMERA_AUTO_RECOVERY
        default n
        help
            Last resort after three failed restarts in a row. The next boot reports
            it separately from other resets.

    config CAMERA_TEST_HOOKS
        bool "camera_test_fault command (provoke a camera outage)"
        depends on CAMERA_RECOVERY_ENABLE
        default n
        help
            For testing the automatic recovery without an ESD gun. Not for field
            firmware.

    # Derived, no prompt: status and reset-reason reporting for any of the above.
    config CAMERA_STATUS
        bool
        default y if CAMERA_POWER_CONTROL || CAMERA_RECOVERY_ENABLE

endmenu
```
