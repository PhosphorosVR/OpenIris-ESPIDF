## main/Kconfig.projbuild
```kconfig
menu "ENV_Caps"

    orsource "$IDF_PATH/examples/common_components/env_caps/$IDF_TARGET/Kconfig.env_caps"

endmenu

menu "OpenIris: General Configuration"

    config START_IN_UVC_MODE
        bool "Start in UVC Mode"
        default false
        help
            Enables UVC (wired) support in the firmware by default.
            To be used when a board is designed to be used primarily with wired headsets.
            When enabled, the default device streaming mode will be UVC unless overridden by a
            saved preference. When disabled, the default mode is AUTO.

    config GENERAL_DEFAULT_WIRED_MODE
        bool "Wired mode"
        default false
        help
            Enables UVC (wired) support in the firmware. When enabled, the
            default device streaming mode will be UVC unless overridden by a
            saved preference. When disabled, the default mode is AUTO.

    config GENERAL_UVC_DELAY
        int "UVC delay (s)"
        default 30
        range 10 10000
        help
            Delay in seconds before the ESP reports itself as a UVC device.

endmenu

menu "OpenIris: Camera Configuration"

    config CAMERA_USB_XCLK_FREQ
        int "USB XCLK frequency (Hz)"
        default 10000000 # should be set in individual board config 
        range 1 24000000
        help
            USB XCLK frequency in Hz.

    config CAMERA_WIFI_XCLK_FREQ
        int "WIFI XCLK frequency (Hz)"
        default 16500000
        range 1 24000000
        help
            WIFI XCLK frequency in Hz.

endmenu

menu "OpenIris: WiFi Configuration"

    config WIFI_MDNS_HOSTNAME
        string "mDNS hostname"
        default "openiristracker"

    config WIFI_SSID
        string "WiFi network name (SSID)"
        default ""

    config WIFI_PASSWORD
        string "WiFi password"
        default ""

    config WIFI_AP_SSID
        string "Access Point WiFi network name (SSID)"
        default "EyeTrackVR"

    config WIFI_AP_PASSWORD
        string "Access Point WiFi password"
        default "12345678"

endmenu

menu "OpenIris: Monitoring"

    config MONITORING_LED_CURRENT
        bool "Enable LED current monitoring"
        default false
        help
            Enables ADC-based current monitoring for the external IR LEDs.

    config MONITORING_LED_ADC_GPIO
        int "ADC GPIO for LED current sense"
        range ENV_GPIO_RANGE_MIN ENV_GPIO_IN_RANGE_MAX
        default 2
        depends on MONITORING_LED_CURRENT
        help
            GPIO connected to the LED current sense output (goes to ADC input).
            Note: Only specific GPIOs support ADC input. On ESP32-S3 these are typically GPIO1..10 for ADC1.

    config MONITORING_LED_GAIN
        int "Sense path gain/divider factor"
        default 11
    depends on MONITORING_LED_CURRENT
        help
            Overall analog gain (or divider factor) between shunt voltage and ADC input.
            The measured ADC voltage will be divided by this factor (e.g., 11).

    config MONITORING_LED_SHUNT_MILLIOHM
        int "Shunt resistance (mΩ)"
    range 1 1000000
        default 22
    depends on MONITORING_LED_CURRENT
        help
            Value of the current-sense shunt resistor in milliohms.

    config MONITORING_LED_SAMPLES
        int "Number of samples for moving average"
        range 1 200
        default 10
    depends on MONITORING_LED_CURRENT
        help
            Number of ADC samples to average for a smoother reading.

    config MONITORING_LED_INTERVAL_MS
        int "Sampling interval (ms)"
        range 5 10000
        default 50
    depends on MONITORING_LED_CURRENT
        help
            Time between ADC samples in milliseconds.


endmenu

menu "OpenIris: LED Configuration"

    config LED_DEBUG_GPIO
        int "Debug LED GPIO number"
        range ENV_GPIO_RANGE_MIN ENV_GPIO_OUT_RANGE_MAX
        default 8
        help
            GPIO number (IOxx) used to drive the on-board debug/status LED.
            Some GPIOs are reserved for other functions (e.g. flash) and cannot be used.

    config LED_EXTERNAL_GPIO
        int "GPIO pin controlling external LEDs"
        range ENV_GPIO_RANGE_MIN ENV_GPIO_OUT_RANGE_MAX
        default 1
        depends on LED_EXTERNAL_CONTROL
        help
            GPIO number connected to the control line of the external IR LEDs.

    config LED_EXTERNAL_CONTROL
        bool "Board supports external IR LED control"
        default false
        help
            Enable this if your board can control external IR LEDs.


    config LED_DEBUG_USE_EXTERNAL
        bool "Mirror error pattern on external LED (PWM)"
        default false
        depends on LED_EXTERNAL_CONTROL
        help
            When enabled, the external illuminator LED (PWM) will mirror the same error blink
            pattern as the debug LED. Useful for boards without a dedicated debug LED, but also
            works in combination with one. Non-error states do not affect the external LED.

    config LED_EXTERNAL_PWM_FREQ
        int "External LED PWM frequency (Hz)"
        default 5000
        range 1 40000
        depends on LED_EXTERNAL_CONTROL
        help
            Frequency of the PWM signal driving the external IR LEDs.

    config LED_EXTERNAL_PWM_DUTY_CYCLE
        int "External LED PWM duty cycle (%)"
        default 50
        range 0 100
        depends on LED_EXTERNAL_CONTROL
        help
            Duty cycle of the PWM signal for external IR LEDs, in percent.
            0 means always off, 100 means always on.

endmenu
```
